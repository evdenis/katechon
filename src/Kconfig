## src/Kconfig
```kconfig
config SECURITY_KATECHON
	bool "KATECHON Integrity contol module"
	depends on SECURITY
	default n
	help
	  This selects the KATECHON security module.
	  If you are unsure how to answer this question, answer N.
```
